#include <stdio.h>
#include "HAL/inc/util.h"
#include "HAL/inc/nrf24.h"
#include "HAL/inc/eeprom.h"

#include "HAL/inc/stm8.h"

int main()
{
    int count = 0;
    unsigned long i = 0;
    CLK_CKDIVR = 0x00;  // Set the frequency to 16 MHz
    CLK_PCKENR1 = 0xFF; // Enable peripherals
    CLK_PCKENR2 = 0xFF;

    UART1_CR2 = UART_CR2_TEN;                        // Allow TX and RX
    UART1_CR3 &= ~(UART_CR3_STOP1 | UART_CR3_STOP2); // 1 stop bit
    UART1_BRR2 = 0x03;
    UART1_BRR1 = 0x68; // 9600 baud


    nrf24_init();
    nrf24_setup();
    nrf24_printDetails();
    eeprom_init();

    while (1)
    {
        uint8_t data[] = {0x54, 0x68, 0x65, 0x20, 0x69, 0x6E, 0x74, 0x65, 0x72, 0x72, 0x75, 0x70, 0x74, 0x20, 0x68, 0x61, 0x6E, 0x64, 0x6C,
                          0x65, 0x72, 0x20, 0x69, 0x73, 0x20, 0x64, 0x65, 0x63, 0x6C, 0x61, 0x72, 0x65, 0x64, 0x20, 0x77, 0x69, 0x74, 0x68,
                          0x20, 0x5F, 0x5F, 0x6E, 0x61, 0x6B, 0x65, 0x64, 0x20, 0x61, 0x74, 0x74, 0x72, 0x69, 0x62, 0x75, 0x74, 0x65, 0x2C,
                          0x20, 0x77, 0x68, 0x69, 0x63, 0x68, 0x20, 0x69, 0x6E, 0x73, 0x74, 0x72, 0x75, 0x63, 0x74, 0x73, 0x20, 0x53, 0x44,
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                          0x6F, 0x6E, 0x20, 0x61, 0x6E, 0x79, 0x77, 0x61, 0x79, 0x2E};

        
        eeprom_write(0x01, data, 295);
        eeprom_write_byte(0x24, 9);

        // printf("%s\r\n", data);
        printf("hello %d\r\n", sizeof(int));

        for (volatile long int j = 400000; j > 0; j--)
            ;
        for (int i = 1; i < 295; i++)
            printf("%c",(char)eeprom_byte_read(i));

        for (volatile long int j = 400000; j > 0; j--)
            ;
    }
}
